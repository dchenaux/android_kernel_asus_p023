## linux-3.10/drivers/input/sensors/Kconfig
```kconfig
#
# Sensor drivers configuration
#

config SENSORS_CM36686
        bool "CM36686 Proximity & Light Sensor"
        depends on I2C

config SENSORS_AL3320A
        bool "AL3320A Light Sensor"
        depends on I2C

config HALL_SENSOR
       bool "Hall sensor"
       default n
       help
          Say Y here if you want enable hall sensor driver
          If unsure, say N.

config SENSORS_AP3425
        bool "AP3425 Proximity & Light Sensor"
        depends on I2C
```

## linux-3.10/drivers/video/xgold/dsi/Kconfig
```kconfig
config XGOLD_MIPI_DSI
	bool "XGold MIPI DSI transmitter support"
	depends on X86_INTEL_XGOLD
	default y
	help
	  XGold MIPI DSI transmitter support
	  It is used by rockchip framebuffer driver.
	  Say y to use
	  XGold MIPI DSI transmitter.

config SONY_CADIZ
	bool "SONY CADIZ support"
	help
	  SONY CADIZ support
	  Say y to use
```
